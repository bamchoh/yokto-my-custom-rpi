## conf/bblayers.conf
```bitbake
# POKY_BBLAYERS_CONF_VERSION is increased each time build/conf/bblayers.conf
# changes incompatibly
POKY_BBLAYERS_CONF_VERSION = "2"

BBPATH = "${TOPDIR}"
BBFILES ?= ""

BBLAYERS ?= " \
  /home/bamchoh/x-build-pi/poky/meta \
  /home/bamchoh/x-build-pi/poky/meta-poky \
  /home/bamchoh/x-build-pi/poky/meta-yocto-bsp \
  "


BBLAYERS += "${TOPDIR}/../meta-raspberrypi"
BBLAYERS += "${TOPDIR}/../meta-openembedded/meta-python"
BBLAYERS += "${TOPDIR}/../meta-openembedded/meta-oe"
BBLAYERS += "${TOPDIR}/../meta-openembedded/meta-networking"
BBLAYERS += "${TOPDIR}/../meta-openembedded/meta-filesystems"
BBLAYERS += "${TOPDIR}/../meta-rpi-mycustom"
```
